// SPDX-License-Identifier: (GPL-2.0+ OR MIT)
/*
 * HY300 Pro projector, box label HY300PRO-G-EU (stock Android 11 of
 * 2025-05-06) -- the maintainer's own board. It is not the HY300 Pro of
 * issue #1, whose tree is sun50i-h713-hy300-pro.dts.
 *
 * An include of the HY310's tree, because this board is HY310-like where it
 * has been measured: the same DRAM words (they live in
 * configs/hy300pro_g_eu_defconfig, not here), the same 26-entry partition
 * table, the same display.bin. The panel (declared project id 0x34, 1280x720)
 * is not described here; the display coprocessor drives it from its own
 * tables. The tree exists so that a boot log names the board it runs on.
 */

#include "sun50i-h713-hy310.dts"

/ {
	model = "HY300 Pro (HY300PRO-G-EU)";
	compatible = "magcubic,hy300pro-g-eu", "allwinner,sun50i-h713";
};
